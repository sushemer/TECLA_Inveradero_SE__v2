## Pruebas/Prueba_3/main/Kconfig.projbuild
```kconfig
menu "Prueba 3: consumo del nodo"

menu "01. Nodo y ventana de medición"

config PRUEBA_ID_NODO
    int "Identificador del nodo"
    range 1 4
    default 1

config PRUEBA_PERFIL_NODO
    int "Perfil: 1=C3 DHT22, 2=C3 DHT22+luz, 3=C3 DHT22, 4=WROOM humedad"
    range 1 4
    default 1

config PRUEBA_CPU_ACTIVO
    int "CPU activo (0=desactivado, 1=activado)"
    range 0 1
    default 1

config PRUEBA_TIEMPO_VENTANA_ACTIVA_S
    int "Duración de la ventana activa (s; 0=indefinida)"
    range 0 86400
    default 60

config PRUEBA_ESPERA_INICIAL_S
    int "Pausa inicial para conectar el instrumento (s)"
    range 0 600
    default 5

config PRUEBA_INTERVALO_LECTURAS_S
    int "Tiempo entre lecturas de sensores (s)"
    range 2 86400
    default 600

endmenu

menu "02. Comunicación ESP-NOW"

config PRUEBA_ESPNOW_RECEPCION
    int "Escuchar ESP-NOW (0=desactivado, 1=activado)"
    range 0 1
    default 0
    help
        Mantiene Wi-Fi y ESP-NOW activos, sin ahorro de radio, durante la ventana activa.
        No procesa ni valida los datos recibidos.

config PRUEBA_ESPNOW_TRANSMISION
    int "Transmitir paquetes de prueba (0=desactivado, 1=activado)"
    range 0 1
    default 0
    help
        Envía paquetes broadcast sin confirmación ni validación de recepción.

config PRUEBA_ESPNOW_CANAL
    int "Canal ESP-NOW (igual en todos los equipos)"
    range 1 13
    default 1

config PRUEBA_ESPNOW_INTERVALO_TRANSMISION_MS
    int "Intervalo entre transmisiones (ms)"
    range 10 60000
    default 1000

endmenu

menu "03. Sensores y cargas conectadas"

config PRUEBA_SENSOR_DHT22
    int "DHT22 conectado (0=no, 1=sí)"
    range 0 1
    default 0

config PRUEBA_SENSOR_VEML7700
    int "VEML7700 conectado (0=no, 1=sí)"
    range 0 1
    default 0

config PRUEBA_SENSOR_ADS1115
    int "ADS1115 conectado (0=no, 1=sí)"
    range 0 1
    default 0

config PRUEBA_SENSOR_SEN0193_1
    int "SEN0193 número 1 conectada (0=no, 1=sí)"
    range 0 1
    default 0

config PRUEBA_SENSOR_SEN0193_2
    int "SEN0193 número 2 conectada (0=no, 1=sí)"
    range 0 1
    default 0

config PRUEBA_SENSOR_SEN0193_3
    int "SEN0193 número 3 conectada (0=no, 1=sí)"
    range 0 1
    default 0

config PRUEBA_SENSOR_SEN0193_4
    int "SEN0193 número 4 conectada (0=no, 1=sí)"
    range 0 1
    default 0

config PRUEBA_CARGA_DIVISOR_BATERIA
    int "Divisor de batería 220 kΩ + 100 kΩ conectado (0=no, 1=sí)"
    range 0 1
    default 0

config PRUEBA_CARGA_TPS63020
    int "TPS63020 en ruta de alimentación (0=no, 1=sí)"
    range 0 1
    default 0

endmenu

menu "04. Ahorro de energía"

config PRUEBA_USAR_SUENO_PROFUNDO
    int "Entrar a sueño profundo al terminar la ventana (0=no, 1=sí)"
    range 0 1
    default 0

config PRUEBA_DURACION_SUENO_PROFUNDO_S
    int "Duración del sueño profundo (s)"
    range 1 86400
    default 600

endmenu

endmenu
```

## firmware/gateway/Kconfig.projbuild
```kconfig
menu "TECLA gateway"

config TECLA_GATEWAY_API_BASE_URL
    string "API base URL (vacía = modo local/offline)"
    default ""
    help
        Base URL del API, por ejemplo https://servidor.example/api.
        No incluya usuario, contraseña, query ni fragmento en la URL.
        Vacía desactiva conexión STA y POST central; el AP local y ESP-NOW
        continúan activos. En el firmware actual se concatena /lecturas;
        las rutas gateway v1 y autenticación aún no están integradas.

config TECLA_GATEWAY_WIRE_V3_RADIO
    bool "Enable experimental v3 telemetry receiver"
    depends on ESP_WIFI_ENABLED
    default n
    help
        Route v3 telemetry to the bounded volatile dispatcher using only the
        explicit firmware_node_id/MAC bindings in gateway_config.local.h.
        Disabled by default until target build and physical interoperability
        are verified. No central commit or CCMP is provided by this option.

endmenu
```

## firmware/nodo/Kconfig.projbuild
```kconfig
menu "TECLA node commissioning"

config TECLA_NODE_IDENTITY_CONSOLE
	bool "Enable physical identity provisioning console"
	depends on ESP_CONSOLE_UART
	default n
	help
	  Enable an interactive identity command on the configured ESP-IDF UART
	  console. This is intended for authorized physical commissioning only.
	  Keep disabled in deployed builds unless local serial access is controlled.

config TECLA_NODE_WIRE_V3_RADIO
	bool "Enable experimental v3 ESP-NOW telemetry sender"
	depends on ESP_WIFI_ENABLED
	default n
	help
	  Use the provisioned firmware_node_id and the local gateway MAC/channel
	  from node_config.local.h. Disabled by default until target build and
	  physical radio interoperability are verified. No CCMP is configured.

endmenu
```
